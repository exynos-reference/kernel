## Documentation/devicetree/bindings/arm/exynos/ppmu-exynos5.txt
```
Exynos PPMU driver
-------------------

Performance events are primitive values used to get performance data. These
events provide information about the behavior of the SoC that can be used
when analyzing system performance. These events are made visible using the
PPMU logic.
Exynos PPMU driver is used by the exynos5 devfreq drivers to control the
bus frequency/voltage.

Required properties:
- compatible: "samsung,exynos5250-int-busfreq", "samsung,exynos5420-int-busfreq"
- reg:
	* physical base address of the PPMUs (e.g DDR, Right Bus, Left bus etc)
	and length of memory mapped region.

Example:
--------

	ppmu {
		compatible = "samsung,exynos5250-int-busfreq";
		reg = <0x10C40000 0x2000
		       0x10C50000 0x2000
		       0x10C60000 0x2000
		       0x10CB0000 0x2000
		       0x13660000 0x2000>;
	};
```

## Documentation/devicetree/bindings/mfd/max77802.txt
```
Maxim MAX77802 multi-function device

MAX77802 is a Multifunction device with PMIC, RTC and Charger on chip. It is
interfaced to host controller using i2c interface. PMIC, Charger and RTC
submodules are addressed using same i2c slave address.

This document describes the binding for mfd device and PMIC submodule.

Binding for the built-in 32k clock generator block is defined separately
in bindings/clk/maxim,max77802.txt file.

Required properties:
- compatible : Must be "maxim,max77802";
- reg : Specifies the i2c slave address of PMIC block.
- interrupts : This i2c device has an IRQ line connected to the main SoC.
- interrupt-parent : The parent interrupt controller.

Optional node:
- regulators : The regulators of max77802 have to be instantiated
  under subnode named "regulators" using the following format.

	regulator-name {
		standard regulator constraints....
	};
	refer Documentation/devicetree/bindings/regulator/regulator.txt

  The regulator node name should be initialized with a string
to get matched with their hardware counterparts as follow. The valid names are:

	-LDOn 	:	for LDOs, where n can lie in range 1 to 35.
			example: LDO1, LDO2, LDO35.
	-BUCKn 	:	for BUCKs, where n can lie in range 1 to 10.
			example: BUCK1, BUCK5, BUCK10.
Example:

	max77802@09 {
		compatible = "maxim,max77802";
		interrupt-parent = <&wakeup_eint>;
		interrupts = <26 0>;
		reg = <0x09>;
		#address-cells = <1>;
		#size-cells = <0>;

		regulators {
			ldo11_reg: LDO11 {
				regulator-name = "vdd_ldo11";
				regulator-min-microvolt = <1900000>;
				regulator-max-microvolt = <1900000>;
				regulator-always-on;
			};

			buck1_reg: BUCK1 {
				regulator-name = "vdd_mif";
				regulator-min-microvolt = <950000>;
				regulator-max-microvolt = <1300000>;
				regulator-always-on;
				regulator-boot-on;
			};
	};
```

## Documentation/devicetree/bindings/panel/panel-lvds.txt
```
panel interface for eDP/lvds panels

Required properties:
  - compatible: "panel-lvds"

Optional properties:
	-lcd-en-gpio:
		panel LCD poweron GPIO.
			Indicates which GPIO needs to be powered up as output
			to powerup/enable the switch to the LCD panel.
	-led-en-gpio:
		panel LED enable GPIO.
			Indicates which GPIO needs to be powered up as output
			to enable the backlight.
	-panel-prepare-delay:
		delay value in ms required for panel_prepare process
			Delay in ms needed for the panel LCD unit to
			powerup completely.
			ex: delay needed till eDP panel throws HPD.
			    delay needed so that we cans tart reading edid.
	-panel-enable-delay:
		delay value in ms required for panel_enable process
			Delay in ms needed for the panel backlight/LED unit
			to powerup, and delay needed between video_enable and
			backlight_enable.
	-panel-disable-delay:
		delay value in ms required for panel_disable process
			Delay in ms needed for the panel backlight/LED unit
			powerdown, and delay needed between backlight_disable
			and video_disable.
	-panel-unprepare-delay:
		delay value in ms required for panel_post_disable process
			Delay in ms needed for the panel LCD unit to
			to powerdown completely, and the minimum delay needed
			before powering it on again.
	-panel-width-mm: physical panel width [mm]
	-panel-height-mm: physical panel height [mm]

Example:

	panel-lvds {
		compatible = "panel-lvds";
		led-en-gpio = <&gpx3 0 1>;
		panel-prepare-delay = <40>;
		panel-enable-delay = <20>;
		panel-disable-delay = <20>;
		panel-unprepare-delay = <30>;
		panel-width-mm = <256>;
		panel-height-mm = <144>;
	};
```

## Documentation/devicetree/bindings/video/bridge/ps8622.txt
```
ps8622-bridge bindings

Required properties:
	- compatible: "parade,ps8622" or "parade,ps8625"
	- reg: first i2c address of the bridge
	- sleep-gpios: OF device-tree gpio specification for PD_ pin.
	- reset-gpios: OF device-tree gpio specification for RST_ pin.

Optional properties:
	- lane-count: number of DP lanes to use
	- use-external-pwm: backlight will be controlled by an external PWM

Example:
	lvds-bridge@48 {
		compatible = "parade,ps8622";
		reg = <0x48>;
		sleep-gpios = <&gpc3 6 1 0 0>;
		reset-gpios = <&gpc3 1 1 0 0>;
		lane-count = <1>;
	};
```

## drivers/gpu/drm/bridge/Kconfig
```kconfig
config DRM_PTN3460
	tristate "PTN3460 DP/LVDS bridge"
	depends on DRM
	depends on OF && I2C
	select DRM_KMS_HELPER
	select DRM_PANEL
	---help---
	  ptn3460 eDP-LVDS bridge chip driver.

config DRM_PS8622
	tristate "Parade eDP/LVDS bridge"
	depends on OF && I2C
	select DRM_PANEL
	select BACKLIGHT_LCD_SUPPORT
	select BACKLIGHT_CLASS_DEVICE
	---help---
	  parade eDP-LVDS bridge chip driver.
```

## drivers/gpu/drm/panel/Kconfig
```kconfig
config DRM_PANEL
	bool
	depends on DRM
	help
	  Panel registration and lookup framework.

menu "Display Panels"
	depends on DRM_PANEL

config DRM_PANEL_SIMPLE
	tristate "support for simple panels"
	depends on OF
	help
	  DRM panel driver for dumb panels that need at most a regulator and
	  a GPIO to be powered up. Optionally a backlight can be attached so
	  that it can be automatically turned off when the panel goes into a
	  low power state.

config DRM_PANEL_LD9040
	tristate "LD9040 RGB/SPI panel"
	depends on DRM && DRM_PANEL
	depends on OF
	select SPI
	select VIDEOMODE_HELPERS

config DRM_PANEL_S6E8AA0
	tristate "S6E8AA0 DSI video mode panel"
	depends on DRM && DRM_PANEL
	depends on OF
	select DRM_MIPI_DSI
	select VIDEOMODE_HELPERS

config DRM_PANEL_EDP_LVDS
	tristate "support for eDP/LVDS panels"
	depends on OF && DRM_PANEL
	select VIDEOMODE_HELPERS
	help
	  DRM panel driver for direct eDP panels or LVDS connected
	  via DP bridges, that need at most a regulator for LCD unit,
	  a regulator for LED unit and/or enable GPIOs for LCD or LED units.
	  Delay values can also be specified to support powerup and
	  powerdown process.
endmenu
```
